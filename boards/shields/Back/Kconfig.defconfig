## boards/shields/Back/Kconfig.defconfig
```kconfig
if SHIELD_BACK

# Name must be less than 16 characters long!
config ZMK_KEYBOARD_NAME
    default "Back"

# Input Device(pmw3610)のためのコンフィグ
config ZMK_POINTING
    default y

config SPI
    default y

endif
```

## boards/shields/Back/Kconfig.shield
```kconfig
#No whitespace after the comma or in your part name!
config SHIELD_BACK
	def_bool $(shields_list_contains,Back)
```

## boards/shields/ZaruBall/Kconfig.defconfig
```kconfig
if SHIELD_ZARUBALL_DONGLE

# Name must be less than 16 characters long!
config ZMK_KEYBOARD_NAME
    default "ZaruBall"

config ZMK_SPLIT_ROLE_CENTRAL
    default y

config ZMK_SPLIT_BLE_CENTRAL_PERIPHERALS
    default 2

endif

if SHIELD_ZARUBALL_LEFT || SHIELD_ZARUBALL_RIGHT || SHIELD_ZARUBALL_DONGLE

config ZMK_SPLIT
    default y

endif

if SHIELD_ZARUBALL_DONGLE || SHIELD_ZARUBALL_RIGHT

config ZMK_POINTING
    default y

endif

if SHIELD_ZARUBALL_RIGHT

# Assuming pointing device uses SPI
config SPI
    default y

endif
```

## config/west.yml
```yaml
manifest:
  remotes:
    - name: zmkfirmware
      url-base: https://github.com/zmkfirmware
    - name: badjeff
      url-base: https://github.com/badjeff
    - name: caksoylar
      url-base: https://github.com/caksoylar
    - name: ImSota
      url-base: https://github.com/ImSota
    - name: ImSota
      url-base: https://github.com/ImSota
  projects:
    - name: zmk
      remote: zmkfirmware
      revision: v0.3
      import: app/west.yml
    - name: zmk-pmw3610-driver
      remote: ImSota
      revision: zmk-0.3
    - name: zmk-rgbled-widget
      remote: caksoylar
      revision: main
    - name: zmk-twist-sync
      remote: ImSota
      revision: main
  self:
    path: config
```
